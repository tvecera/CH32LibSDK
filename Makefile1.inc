
# Path to _devices directory (without trailing '/' delimiter)
CH32LIBSDK_DEVICES_DIR = ${CH32_ROOT_PATH}/_devices

# Include device
include ${CH32LIBSDK_DEVICES_DIR}/${DEVCLASS}/_makefile.inc

##############################################################################
#              Makefile 1st stage - prepare MCU type
##############################################################################

# Setup from main Makefile:
#   MCU ... target MCU -> MCU serie, MCU class, MCU subclass:
#	CH32V002x4 -> CH32V002, CH32V0, CH32V00X
#	CH32V003x4 -> CH32V003, CH32V0
#	CH32V004x6 -> CH32V004, CH32V0, CH32V00X
#	CH32V005x6 -> CH32V005, CH32V0, CH32V00X
#	CH32V006x4 -> CH32V006, CH32V0, CH32V00X
#	CH32V006x8 -> CH32V006, CH32V0, CH32V00X
#	CH32V007x8 -> CH32V007, CH32V0, CH32V00X
#	CH32X033x8 -> CH32V033, CH32V0, CH32V03X
#	CH32X035x7 -> CH32V035, CH32V0, CH32V03X
#	CH32X035x8 -> CH32V035, CH32V0, CH32V03X
#	CH32V103x6 -> CH32V103, CH32V1
#	CH32V103x8 -> CH32V103, CH32V1
#	CH32L103x8 -> CH32L103, CH32V1
#	CH32V203x6 -> CH32V203, CH32V2
#	CH32V203x8 -> CH32V203, CH32V2
#	CH32V208xB -> CH32V208, CH32V2
#	CH32V303xB -> CH32V303, CH32V3
#	CH32V303xC -> CH32V303, CH32V3
#	CH32V305xB -> CH32V305, CH32V3
#	CH32V305xC -> CH32V305, CH32V3
#	CH32V307xC -> CH32V307, CH32V3
#	CH32V317xC -> CH32V317, CH32V3

#   MCUCLASS
#	CH32V0
#	CH32V1
#	CH32V2
#	CH32V3

#   CH32V0 MCU subclass
#	CH32V003
#	CH32V00X
#	CH32V03X

# MCU class
ifeq ($(MCU),CH32V002x4) # 48MHz, 16KB ROM, 4KB RAM, RISC-V2C (RV32EmC)
MCUSERIE=CH32V002
MCUCLASS=CH32V0
SDK_SUBDIR=ch32v00x
FLASHSIZE=0x4000
RAMSIZE=0x1000
ifeq ($(STACKSIZE),)
STACKSIZE=256
endif
endif

ifeq ($(MCU),CH32V003x4) # 48MHz, 16KB ROM, 2KB RAM, RISC-V2A (RV32EC)
MCUSERIE=CH32V003
MCUCLASS=CH32V0
SDK_SUBDIR=ch32v003
FLASHSIZE=0x4000
RAMSIZE=0x800
ifeq ($(STACKSIZE),)
STACKSIZE=256
endif
endif

ifeq ($(MCU),CH32V004x6) # 48MHz, 32KB ROM, 6KB RAM, RISC-V2C (RV32EmC)
MCUSERIE=CH32V004
MCUCLASS=CH32V0
SDK_SUBDIR=ch32v00x
FLASHSIZE=0x8000
RAMSIZE=0x1800
ifeq ($(STACKSIZE),)
STACKSIZE=384
endif
endif

ifeq ($(MCU),CH32V005x6) # 48MHz, 32KB ROM, 6KB RAM, RISC-V2C (RV32EmC)
MCUSERIE=CH32V005
MCUCLASS=CH32V0
SDK_SUBDIR=ch32v00x
FLASHSIZE=0x8000
RAMSIZE=0x1800
ifeq ($(STACKSIZE),)
STACKSIZE=384
endif
endif

ifeq ($(MCU),CH32V006x4) # 48MHz, 16KB ROM, 4KB RAM, RISC-V2C (RV32EmC)
MCUSERIE=CH32V006
MCUCLASS=CH32V0
SDK_SUBDIR=ch32v00x
FLASHSIZE=0x4000
RAMSIZE=0x1000
ifeq ($(STACKSIZE),)
STACKSIZE=256
endif
endif

ifeq ($(MCU),CH32V006x8) # 48MHz, 62KB ROM, 8KB RAM, RISC-V2C (RV32EmC)
MCUSERIE=CH32V006
MCUCLASS=CH32V0
SDK_SUBDIR=ch32v00x
FLASHSIZE=0xF800
RAMSIZE=0x2000
ifeq ($(STACKSIZE),)
STACKSIZE=384
endif
endif

ifeq ($(MCU),CH32V007x8) # 48MHz, 62KB ROM, 8KB RAM, RISC-V2C (RV32EmC)
MCUSERIE=CH32V007
MCUCLASS=CH32V0
SDK_SUBDIR=ch32v00x
FLASHSIZE=0xF800
RAMSIZE=0x2000
ifeq ($(STACKSIZE),)
STACKSIZE=384
endif
endif

ifeq ($(MCU),CH32X033x8) # 48MHz, 62KB ROM, 20KB RAM, RISC-V4C (RV32IMAC)
MCUSERIE=CH32V033
MCUCLASS=CH32V0
SDK_SUBDIR=ch32v03x
FLASHSIZE=0xF800
RAMSIZE=0x5000
ifeq ($(STACKSIZE),)
STACKSIZE=512
endif
endif

ifeq ($(MCU),CH32X035x7) # 48MHz, 48KB ROM, 20KB RAM, RISC-V4C (RV32IMAC)
MCUSERIE=CH32V035
MCUCLASS=CH32V0
SDK_SUBDIR=ch32v03x
FLASHSIZE=0xC000
RAMSIZE=0x5000
ifeq ($(STACKSIZE),)
STACKSIZE=512
endif
endif

ifeq ($(MCU),CH32X035x8) # 48MHz, 62KB ROM, 20KB RAM, RISC-V4C (RV32IMAC)
MCUSERIE=CH32V035
MCUCLASS=CH32V0
SDK_SUBDIR=ch32v03x
FLASHSIZE=0xF800
RAMSIZE=0x5000
ifeq ($(STACKSIZE),)
STACKSIZE=1024
endif
endif

ifeq ($(MCU),CH32V103x6) # 80MHz, 32KB ROM, 10KB RAM, RISC-V4A (RV32IMAC)
MCUSERIE=CH32V103
MCUCLASS=CH32V1
SDK_SUBDIR=ch32v103
FLASHSIZE=0x8000
RAMSIZE=0x2800
ifeq ($(STACKSIZE),)
STACKSIZE=384
endif
endif

ifeq ($(MCU),CH32V103x8) # 80MHz, 64KB ROM, 20KB RAM, RISC-V4A (RV32IMAC)
MCUSERIE=CH32V103
MCUCLASS=CH32V1
SDK_SUBDIR=ch32v103
FLASHSIZE=0x10000
RAMSIZE=0x5000
ifeq ($(STACKSIZE),)
STACKSIZE=512
endif
endif

ifeq ($(MCU),CH32L103x8) # 96MHz, 64KB ROM, 20KB RAM, RISC-V4C (RV32IMAC)
MCUSERIE=CH32L103
MCUCLASS=CH32V1
SDK_SUBDIR=ch32l103
FLASHSIZE=0x10000
RAMSIZE=0x5000
ifeq ($(STACKSIZE),)
STACKSIZE=512
endif
endif

ifeq ($(MCU),CH32V203x6) # 144MHz, 32KB ROM, 10KB RAM, RISC-V4B (RV32IMAC)
MCUSERIE=CH32V203
MCUCLASS=CH32V2
SDK_SUBDIR=ch32v2
FLASHSIZE=0x8000
RAMSIZE=0x2800
ifeq ($(STACKSIZE),)
STACKSIZE=384
endif
endif

ifeq ($(MCU),CH32V203x8) # 144MHz, 64KB ROM, 20KB RAM, RISC-V4B (RV32IMAC)
MCUSERIE=CH32V203
MCUCLASS=CH32V2
SDK_SUBDIR=ch32v2
FLASHSIZE=0x10000
RAMSIZE=0x5000
ifeq ($(STACKSIZE),)
STACKSIZE=512
endif
endif

ifeq ($(MCU),CH32V208xB) # 144MHz, 128KB ROM, 64KB RAM, RISC-V4C (RV32IMAC)
MCUSERIE=CH32V208
MCUCLASS=CH32V2
SDK_SUBDIR=ch32v2
FLASHSIZE=0x20000
RAMSIZE=0x10000
ifeq ($(STACKSIZE),)
STACKSIZE=768
endif
endif

ifeq ($(MCU),CH32V303xB) # 144MHz, 128KB ROM, 32KB RAM, RISC-V4F (RV32IMAC)
MCUSERIE=CH32V303
MCUCLASS=CH32V3
SDK_SUBDIR=ch32v2
FLASHSIZE=0x20000
RAMSIZE=0x8000
ifeq ($(STACKSIZE),)
STACKSIZE=512
endif
endif

ifeq ($(MCU),CH32V303xC) # 144MHz, 256KB ROM, 64KB RAM, RISC-V4F (RV32IMAC)
MCUSERIE=CH32V303
MCUCLASS=CH32V3
SDK_SUBDIR=ch32v2
FLASHSIZE=0x40000
RAMSIZE=0x10000
ifeq ($(STACKSIZE),)
STACKSIZE=1024
endif
endif

ifeq ($(MCU),CH32V305xB) # 144MHz, 128KB ROM, 32KB RAM, RISC-V4F (RV32IMAC)
MCUSERIE=CH32V305
MCUCLASS=CH32V3
SDK_SUBDIR=ch32v2
FLASHSIZE=0x20000
RAMSIZE=0x8000
ifeq ($(STACKSIZE),)
STACKSIZE=512
endif
endif

ifeq ($(MCU),CH32V305xC) # 144MHz, 256KB ROM, 64KB RAM, RISC-V4F (RV32IMAC)
MCUSERIE=CH32V305
MCUCLASS=CH32V3
SDK_SUBDIR=ch32v2
FLASHSIZE=0x40000
RAMSIZE=0x10000
ifeq ($(STACKSIZE),)
STACKSIZE=1024
endif
endif

ifeq ($(MCU),CH32V307xC) # 144MHz, 256KB ROM, 64KB RAM, RISC-V4F (RV32IMAC)
MCUSERIE=CH32V307
MCUCLASS=CH32V3
SDK_SUBDIR=ch32v2
FLASHSIZE=0x40000
RAMSIZE=0x10000
ifeq ($(STACKSIZE),)
STACKSIZE=1024
endif
endif

ifeq ($(MCU),CH32V317xC) # 144MHz, 256KB ROM, 64KB RAM, RISC-V4F (RV32IMAC)
MCUSERIE=CH32V317
MCUCLASS=CH32V3
SDK_SUBDIR=ch32v2
FLASHSIZE=0x40000
RAMSIZE=0x10000
ifeq ($(STACKSIZE),)
STACKSIZE=1024
endif
endif
